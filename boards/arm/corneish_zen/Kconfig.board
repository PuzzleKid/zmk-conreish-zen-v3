## boards/arm/corneish_zen/Kconfig.board
```kconfig
#
# Copyright (c) 2022 Darryl deHaan
# SPDX-License-Identifier: MIT
#

config BOARD_CORNEISH_ZEN_V1_LEFT
    bool "corneish zen left v1"
    depends on SOC_NRF52840_QIAA
    select BOARD_CORNEISH_ZEN_LEFT

config BOARD_CORNEISH_ZEN_V1_RIGHT
    bool "corneish zen right v1"
    depends on SOC_NRF52840_QIAA
    select BOARD_CORNEISH_ZEN_RIGHT

config BOARD_CORNEISH_ZEN_V3_LEFT
    bool "corneish zen left v3"
    depends on SOC_NRF52840_QIAA
    select BOARD_CORNEISH_ZEN_LEFT

config BOARD_CORNEISH_ZEN_V3_RIGHT
    bool "corneish zen right v3"
    depends on SOC_NRF52840_QIAA
    select BOARD_CORNEISH_ZEN_RIGHT
```
